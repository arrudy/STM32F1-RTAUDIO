## CMakeLists.txt
```
# SPDX-License-Identifier: Apache-2.0

cmake_minimum_required(VERSION 3.20.0)

find_package(Zephyr REQUIRED HINTS $ENV{ZEPHYR_BASE})
project(VoiRunner)

file(GLOB SRCS src/*.c)
target_sources(app PRIVATE ${SRCS})


target_compile_options(app PRIVATE
    -ffunction-sections
    -fdata-sections
    -fno-common
)

target_link_options(app PRIVATE
    -Wl,--gc-sections
    -Wl,--print-gc-sections
)

target_link_options(app PUBLIC 
    "-Wl,--defsym,realCoefAQ15=my_realCoefAQ15"
    "-Wl,--defsym,realCoefBQ15=my_realCoefBQ15"
)


target_include_directories(app PRIVATE include)
```

## Kconfig
```
# Copyright (c) 2023 Synopsys.
#
# SPDX-License-Identifier: Apache-2.0
mainmenu "VoiRunner Application"

config VOIRUNNER_LL_DRIVERS
    bool "Enable Low Level Drivers"
    default y
    depends on SOC_SERIES_STM32F1X
    
    # We explicitly select the LL drivers we need for 'main.c'
    select USE_STM32_LL_TIM   # <--- This gives us stm32_ll_tim.h and the library
    select USE_STM32_LL_ADC   # <--- Already selected by CONFIG_ADC, but explicit is safe
    select USE_STM32_LL_DMA   # <--- For clock control
    select USE_STM32_LL_RCC   # <--- For clock control
    select USE_STM32_LL_UTILS # <--- For system utilities/delays
    select USE_STM32_LL_GPIO

source "Kconfig.zephyr"
```

## sample.yaml
```
sample:
  description: minimal sample, the smallest possible Zephyr application
  name: minimal
common:
  tags: footprint
  harness: console
  harness_config:
    type: one_line
    regex:
      - "Hello World from minimal!"
tests:
  sample.minimal.mt.arm:
    extra_args: CONF_FILE='common.conf;mt.conf;arm.conf'
    build_only: true
    platform_allow:
      - frdm_k64f
      - mps2/an385
      - nrf51dk/nrf51822
      - nucleo_f429zi
      - disco_l475_iot1
      - xg29_rb4412a
    integration_platforms:
      - frdm_k64f
  sample.minimal.mt-no-preempt.arm:
    extra_args: CONF_FILE='common.conf;mt.conf;no-preempt.conf;arm.conf'
    build_only: true
    platform_allow:
      - frdm_k64f
      - mps2/an385
      - nrf51dk/nrf51822
      - nucleo_f429zi
      - disco_l475_iot1
      - xg29_rb4412a
    integration_platforms:
      - frdm_k64f
  sample.minimal.mt-no-preempt-no-timers.arm:
    extra_args: CONF_FILE='common.conf;mt.conf;no-preempt.conf;no-timers.conf;arm.conf'
    build_only: true
    platform_allow:
      - frdm_k64f
      - mps2/an385
      - nrf51dk/nrf51822
      - nucleo_f429zi
      - disco_l475_iot1
      - xg29_rb4412a
    integration_platforms:
      - frdm_k64f
  sample.minimal.no-mt.arm:
    extra_args: CONF_FILE='common.conf;no-mt.conf;arm.conf'
    build_only: true
    platform_allow:
      - frdm_k64f
      - mps2/an385
      - nrf51dk/nrf51822
      - nucleo_f429zi
      - disco_l475_iot1
      - xg29_rb4412a
    integration_platforms:
      - frdm_k64f
  sample.minimal.no-mt-no-timers.arm:
    extra_args: CONF_FILE='common.conf;no-mt.conf;no-timers.conf;arm.conf'
    build_only: true
    platform_allow:
      - frdm_k64f
      - mps2/an385
      - nrf51dk/nrf51822
      - nucleo_f429zi
      - disco_l475_iot1
      - xg29_rb4412a
    integration_platforms:
      - frdm_k64f
  sample.minimal.mt.x86:
    extra_args: CONF_FILE='common.conf;mt.conf;x86.conf'
    build_only: true
    platform_allow: qemu_x86
  sample.minimal.mt-no-preempt.x86:
    extra_args: CONF_FILE='common.conf;mt.conf;no-preempt.conf;x86.conf'
    build_only: true
    platform_allow: qemu_x86
  sample.minimal.mt-no-preempt-no-timers.x86:
    extra_args: CONF_FILE='common.conf;mt.conf;no-preempt.conf;no-timers.conf;x86.conf'
    build_only: true
    platform_allow: qemu_x86
  sample.minimal.no-mt.x86:
    extra_args: CONF_FILE='common.conf;no-mt.conf;x86.conf'
    build_only: true
    platform_allow: qemu_x86
  sample.minimal.no-mt-no-timers.x86:
    extra_args: CONF_FILE='common.conf;no-mt.conf;no-timers.conf;x86.conf'
    build_only: true
    platform_allow: qemu_x86
  sample.minimal.arc.runtime:
    extra_args:
      - CONF_FILE='common-runtime.conf;no-timers.conf'
    arch_allow: arc
    tags:
      - kernel
    integration_platforms:
      - qemu_arc/qemu_arc_em
  sample.minimal.riscv.runtime:
    extra_args:
      - CONF_FILE='common-runtime.conf;no-timers.conf;no-mt.conf;riscv.conf'
    platform_allow: qemu_riscv32
    tags:
      - kernel
    integration_platforms:
      - qemu_riscv32
  sample.minimal.no-mt-no-sw-isr-table.arm:
    extra_args: EXTRA_CONF_FILE='common.conf;no-mt.conf;no-sw-isr-table.conf;arm.conf'
    build_only: true
    platform_allow:
      - nrf54l15dk/nrf54l15/cpuapp
      - nrf54lm20dk/nrf54lm20a/cpuapp
  sample.minimal.no-mt-no-sw-isr-table.riscv:
    extra_args: CONF_FILE='common.conf;no-mt.conf;no-sw-isr-table.conf;riscv.conf'
    build_only: true
    platform_allow:
      - nrf54l15dk/nrf54l15/cpuflpr
      - nrf54lm20dk/nrf54lm20a/cpuflpr
```

## prj.conf
```kconfig
#debugging

CONFIG_DEBUG=y
CONFIG_PRINTK=y
CONFIG_LOG=y
CONFIG_LOG_MODE_IMMEDIATE=y

CONFIG_LOG_BACKEND_UART=n
CONFIG_LOG_BACKEND_SWO=y
CONFIG_LOG_BACKEND_SWO_FREQ_HZ=2000000

CONFIG_CONSOLE=y
CONFIG_UART_CONSOLE=n      # Disable UART console to avoid conflicts
CONFIG_SERIAL=y

CONFIG_MULTITHREADING=y
CONFIG_EVENTS=y

CONFIG_DSP=y
CONFIG_CMSIS_DSP=y
CONFIG_CMSIS_DSP_TRANSFORM=y
CONFIG_CMSIS_DSP_COMPLEXMATH=y
```

## stm32_min_dev.overlay
```dts
/ {
	zephyr,user {
	};
};
```

## src/main.c
```c
#include <zephyr/device.h>
#include <zephyr/fatal.h>

/* Low Level Headers */
#include <stm32_ll_adc.h>
#include <stm32_ll_bus.h>
#include <stm32_ll_dma.h>
#include <stm32_ll_tim.h>

#include "processor.h"
#include "common.h"

#include "dma_driver.h"
#include "tim_driver.h"



void k_sys_fatal_error_handler(unsigned int reason, const struct arch_esf *esf)
{
    ARG_UNUSED(reason);

    printk("💥 FATAL ERROR: %u\n", reason);

#if defined(CONFIG_ARM)
    printk("r0  = 0x%08x\n", esf->basic.r0);
    printk("r1  = 0x%08x\n", esf->basic.r1);
    printk("r2  = 0x%08x\n", esf->basic.r2);
    printk("r3  = 0x%08x\n", esf->basic.r3);
    printk("pc  = 0x%08x\n", esf->basic.pc);
    printk("lr  = 0x%08x\n", esf->basic.lr);
    printk("psr = 0x%08x\n", esf->basic.xpsr);
#endif

    while (1) {
        k_cpu_idle();
    }
}


// void ADC1_2_IRQn_IRQHandler(const void * arg)
// {
//     ARG_UNUSED(arg);

//     if(LL_ADC_IsActiveFlag_EOS(ADC1))
//         LL_ADC_ClearFlag_EOS(ADC1);
    
//     printk("ADC!");
// }








static inline void configure_adc1(void)
{
    LL_APB2_GRP1_EnableClock(LL_APB2_GRP1_PERIPH_ADC1);
    ADC1->CR2 = 0; // Reset control register

    // Enable ADC
    LL_ADC_Enable(ADC1);

    // Wait ADC to be ready (optional but recommended)
    while (!LL_ADC_IsEnabled(ADC1)) {}
    LL_ADC_StartCalibration(ADC1);
    while (LL_ADC_IsCalibrationOnGoing(ADC1)) {}

    LL_ADC_SetDataAlignment(ADC1, LL_ADC_DATA_ALIGN_RIGHT);

    LL_ADC_SetChannelSamplingTime(ADC1, LL_ADC_CHANNEL_0, LL_ADC_SAMPLINGTIME_55CYCLES_5);

    // Select external trigger: TIM1 CC1 (EXTSEL=000) and rising edge
    LL_ADC_REG_SetTriggerSource(ADC1, LL_ADC_REG_TRIG_EXT_TIM2_CH2 );
    LL_ADC_REG_StartConversionExtTrig(ADC1, LL_ADC_REG_TRIG_EXT_RISING);
    LL_ADC_REG_SetDMATransfer(ADC1, LL_ADC_REG_DMA_TRANSFER_UNLIMITED );

    // LL_ADC_EnableIT_EOS(ADC1);
    // IRQ_CONNECT(ADC1_2_IRQn,     /* NOT TIM1_IRQn */
    //         0,               /* priority */
    //         ADC1_2_IRQn_IRQHandler,
    //         NULL,
    //         0);
    // irq_enable(ADC1_2_IRQn);
}






int main(void)
{

    configure_adc1();
    configure_dma1();
    LL_DMA_EnableChannel(DMA1,LL_DMA_CHANNEL_1);
    configure_tim1();
    configure_tim2();
    LL_TIM_EnableCounter(TIM1);
    
    printk("Orchestration running at 10Hz. Timer triggering at 16kHz. ADC armed on Hardware Trigger.\n");
    
    while (1) {
        // k_event_wait(&dma_event, 0x1, true, K_FOREVER);
        
        // if (buffers_ready > 1) {
        //     buffers_ready--;
        //     printk("Buffer %d ready\n", BUFFER_LATEST );
        // }
        const uint32_t tracked_events = DMA_CHANNEL1_EV | DMA_CHANNEL2_DISABLE;
        uint32_t status = k_event_wait(&dma_event, tracked_events, false, K_FOREVER);
        
        if(status & DMA_CHANNEL1_EV && *dma1ch1_rdy_cnt() > 1)
        {
            //printk("B%d ready, %d/3\n", dma1ch1_latest(), *dma1ch1_rdy_cnt() );
            k_event_clear(&dma_event, DMA_CHANNEL1_EV);
        }
        if(status & DMA_CHANNEL2_DISABLE)
        {
            printk("P%d/3\n", *dma1ch1_rdy_cnt() );
            proc_tick();
            k_event_clear(&dma_event, DMA_CHANNEL2_DISABLE);
        }
    }
    return 0;
}
```

## include/ABcoef_arr.h
```c
/* Generated Tables for 256 point Real FFT (n=128) */

#include <zephyr/types.h>
typedef int16_t q15_t;

const q15_t my_realCoefAQ15[256] = {
     16384,-16384, 15982,-16379, 15580,-16364, 15179,-16340,
     14778,-16305, 14378,-16261, 13980,-16207, 13583,-16143,
     13188,-16069, 12794,-15986, 12403,-15893, 12014,-15791,
     11628,-15679, 11245,-15557, 10864,-15426, 10487,-15286,
     10114,-15137,  9745,-14978,  9379,-14811,  9018,-14635,
      8661,-14449,  8308,-14256,  7961,-14053,  7619,-13842,
      7282,-13623,  6950,-13395,  6624,-13160,  6304,-12916,
      5990,-12665,  5682,-12406,  5381,-12140,  5087,-11866,
      4799,-11585,  4518,-11297,  4244,-11003,  3978,-10702,
      3719,-10394,  3468,-10080,  3224, -9760,  2989, -9434,
      2761, -9102,  2542, -8765,  2331, -8423,  2128, -8076,
      1935, -7723,  1749, -7366,  1573, -7005,  1406, -6639,
      1247, -6270,  1098, -5897,   958, -5520,   827, -5139,
       705, -4756,   593, -4370,   491, -3981,   398, -3590,
       315, -3196,   241, -2801,   177, -2404,   123, -2006,
        79, -1606,    44, -1205,    20,  -804,     5,  -402,
         0,     0,     5,   402,    20,   804,    44,  1205,
        79,  1606,   123,  2006,   177,  2404,   241,  2801,
       315,  3196,   398,  3590,   491,  3981,   593,  4370,
       705,  4756,   827,  5139,   958,  5520,  1098,  5897,
      1247,  6270,  1406,  6639,  1573,  7005,  1749,  7366,
      1935,  7723,  2128,  8076,  2331,  8423,  2542,  8765,
      2761,  9102,  2989,  9434,  3224,  9760,  3468, 10080,
      3719, 10394,  3978, 10702,  4244, 11003,  4518, 11297,
      4799, 11585,  5087, 11866,  5381, 12140,  5682, 12406,
      5990, 12665,  6304, 12916,  6624, 13160,  6950, 13395,
      7282, 13623,  7619, 13842,  7961, 14053,  8308, 14256,
      8661, 14449,  9018, 14635,  9379, 14811,  9745, 14978,
     10114, 15137, 10487, 15286, 10864, 15426, 11245, 15557,
     11628, 15679, 12014, 15791, 12403, 15893, 12794, 15986,
     13188, 16069, 13583, 16143, 13980, 16207, 14378, 16261,
     14778, 16305, 15179, 16340, 15580, 16364, 15982, 16379
};

const q15_t my_realCoefBQ15[256] = {
     16384, 16384, 16786, 16379, 17188, 16364, 17589, 16340,
     17990, 16305, 18390, 16261, 18788, 16207, 19185, 16143,
     19580, 16069, 19974, 15986, 20365, 15893, 20754, 15791,
     21140, 15679, 21523, 15557, 21904, 15426, 22281, 15286,
     22654, 15137, 23023, 14978, 23389, 14811, 23750, 14635,
     24107, 14449, 24460, 14256, 24807, 14053, 25149, 13842,
     25486, 13623, 25818, 13395, 26144, 13160, 26464, 12916,
     26778, 12665, 27086, 12406, 27387, 12140, 27681, 11866,
     27969, 11585, 28250, 11297, 28524, 11003, 28790, 10702,
     29049, 10394, 29300, 10080, 29544,  9760, 29779,  9434,
     30007,  9102, 30226,  8765, 30437,  8423, 30640,  8076,
     30833,  7723, 31019,  7366, 31195,  7005, 31362,  6639,
     31521,  6270, 31670,  5897, 31810,  5520, 31941,  5139,
     32063,  4756, 32175,  4370, 32277,  3981, 32370,  3590,
     32453,  3196, 32527,  2801, 32591,  2404, 32645,  2006,
     32689,  1606, 32724,  1205, 32748,   804, 32763,   402,
     32767,     0, 32763,  -402, 32748,  -804, 32724, -1205,
     32689, -1606, 32645, -2006, 32591, -2404, 32527, -2801,
     32453, -3196, 32370, -3590, 32277, -3981, 32175, -4370,
     32063, -4756, 31941, -5139, 31810, -5520, 31670, -5897,
     31521, -6270, 31362, -6639, 31195, -7005, 31019, -7366,
     30833, -7723, 30640, -8076, 30437, -8423, 30226, -8765,
     30007, -9102, 29779, -9434, 29544, -9760, 29300,-10080,
     29049,-10394, 28790,-10702, 28524,-11003, 28250,-11297,
     27969,-11585, 27681,-11866, 27387,-12140, 27086,-12406,
     26778,-12665, 26464,-12916, 26144,-13160, 25818,-13395,
     25486,-13623, 25149,-13842, 24807,-14053, 24460,-14256,
     24107,-14449, 23750,-14635, 23389,-14811, 23023,-14978,
     22654,-15137, 22281,-15286, 21904,-15426, 21523,-15557,
     21140,-15679, 20754,-15791, 20365,-15893, 19974,-15986,
     19580,-16069, 19185,-16143, 18788,-16207, 18390,-16261,
     17990,-16305, 17589,-16340, 17188,-16364, 16786,-16379
};
```

## include/common.h
```c
#ifndef COMMON_H
#define COMMON_H

#include <zephyr/kernel.h>

// Helper: This function is called automatically when the 'key' variable goes out of scope
static inline void __irq_unlock_scope(unsigned int *key) {
    irq_unlock(*key);
}

/**
 * @brief Scoped IRQ Lock
 * Creates a block where interrupts are disabled. 
 * Automatically re-enables them at the end of the { } block.
 */
#define IRQ_LOCKED \
    for (unsigned int __key __attribute__((cleanup(__irq_unlock_scope))) = irq_lock(), \
         __once = 1; __once; __once = 0)



#endif
```

## include/dma_driver.h
```c
#ifndef DMA_DRV_H
#define DMA_DRV_H


#define DMA_CHANNEL1_EV 0x01
#define DMA_CHANNEL2_EV 0x02 //when DMA ISR fires for that channel
#define DMA_CHANNEL2_DISABLE 0x04 //no more data to transfer; queue ownership is transferred

extern struct k_event dma_event;


void configure_dma1(void);

int dma1ch1_oldest(void);
int dma1ch1_latest(void);
volatile int * dma1ch1_rdy_cnt(void);
volatile uint16_t * dma1ch1_get(uint32_t idx);



int dma1ch2_rdy(void);
int dma1ch2_memcpy(void *destination , const void* source, size_t size );

#endif
```

## include/processor.h
```c
#ifndef PROCESSOR_H
#define PROCESSOR_H

#include <stdint.h>
#include <stdlib.h>

#include <zephyr/kernel.h>


#define FFT_SIZE     256
#define FFT_SEGMENTS 5
#define BUFFER_COUNT 3


void proc_invalidate();
void proc_acq_next_buffer(volatile uint16_t ** buffer);
int proc_sup_next_buffer(volatile uint16_t * buffer);
int proc_tick();

#endif
```

## include/queue.h
```c
#include <stdint.h>
#include <stddef.h> // for NULL
#include <stdlib.h>

#include "common.h"

typedef struct {
    void * volatile *buffer;      // Pointer to the buffer (now holds void*)
    uint8_t max_size;   // Maximum size of the queue
    volatile uint8_t front;      // Index of the front
    volatile uint8_t size;      // Current number of elements
} Queue;

#define DEFINE_QUEUE(name, count) \
  static void * volatile name##_buffer[count]; \
  static Queue name = { \
    .buffer = name##_buffer, \
    .max_size = count, \
    .front = 0, \
    .size = 0, \
  }

int enqueue(volatile Queue *queue, void *data);
int dequeue(volatile Queue *queue, void **result);
int queue_get(const volatile Queue *queue, uint8_t n, void **result);

inline uint8_t queue_size(const volatile Queue *queue) {return queue->size;}
inline void queue_reset(volatile Queue *queue){
IRQ_LOCKED{
  queue->size = 0;
}
}
```

## include/tim_driver.h
```c
#ifndef TIM_DRIVER_H
#define TIM_DRIVER_H

/*
 * 10 Hz orchestration timer
 *
 */
#define TIM1_PRESCALER 7199 //10k cycles per second
#define TIM1_AUTORELOAD 999
#define TIM1_COMPARE    500


/* 
 * 16 kHz Timer Configuration 
 * 72MHz / 4500 = 16000 Hz 
 */
#define TIM2_PRESCALER 0
#define TIM2_AUTORELOAD 4499 
#define TIM2_COMPARE   2250  /* Trigger halfway through the cycle */

void configure_tim1(void);
void configure_tim2(void);


#endif
```

## src/dma_driver.c
```c
#include <zephyr/device.h>

#include <stm32_ll_dma.h>
#include <stm32_ll_tim.h>
#include <stm32_ll_adc.h>
#include <stm32_ll_bus.h>


#include "common.h"
#include "dma_driver.h"
#include "processor.h"


volatile uint16_t adc_buffer[BUFFER_COUNT][FFT_SIZE] __attribute__((aligned(2)));
volatile int current_buffer = 0; //the one we are currently writing to
volatile int buffers_ready = 0;

K_EVENT_DEFINE(dma_event);



int dma1ch1_oldest(void)
{
    int cur = current_buffer;
    int rdy = buffers_ready;
    int idx = (cur - 1 - rdy) % BUFFER_COUNT;
    if (idx < 0) {
        idx += BUFFER_COUNT;
    }

    return idx;
}

int dma1ch1_latest(void)
{
    return (current_buffer + BUFFER_COUNT - 1 ) % BUFFER_COUNT;
}

volatile uint16_t * dma1ch1_get(uint32_t idx)
{
    if(idx > BUFFER_COUNT) return NULL;
    return adc_buffer[idx];
}



volatile int * dma1ch1_rdy_cnt(void)
{
    return &buffers_ready;
}

int dma1ch2_rdy(void)
{
    return !LL_DMA_IsEnabledChannel(DMA1, LL_DMA_CHANNEL_2);
}


// /\ basically a round robin


void DMA1_Channel1_IRQHandler(const void *arg)
{
    ARG_UNUSED(arg);

    /*
    if (LL_DMA_IsActiveFlag_HT1(DMA1)) { 
        LL_DMA_ClearFlag_HT1(DMA1);
    }*/

    if (LL_DMA_IsActiveFlag_TC1(DMA1)) {  // Transfer Complete
        LL_DMA_ClearFlag_TC1(DMA1);   // Clear flag

        LL_TIM_DisableCounter(TIM2);
        LL_TIM_SetCounter(TIM2, 0); 
        LL_DMA_DisableChannel(DMA1, LL_DMA_CHANNEL_1);


        buffers_ready++;
        current_buffer = (current_buffer + 1) % BUFFER_COUNT;


        if(dma1ch2_rdy() &&                                         // CH2 idle, 
            (
                !k_event_test(&dma_event, DMA_CHANNEL2_DISABLE) &&  // not locked
                !LL_DMA_IsActiveFlag_TC2(DMA1)                      // and not awaiting ISR access
            ))
        {
            volatile uint16_t * next_address;
            proc_acq_next_buffer(&next_address);
            dma1ch2_memcpy((void*)next_address ,(void*)adc_buffer[dma1ch1_oldest()], FFT_SIZE );
        }

        
        LL_DMA_SetMemoryAddress(DMA1, LL_DMA_CHANNEL_1, (uint32_t)adc_buffer[current_buffer]);
        LL_DMA_SetDataLength(DMA1, LL_DMA_CHANNEL_1, FFT_SIZE);
        LL_DMA_EnableChannel(DMA1, LL_DMA_CHANNEL_1);

        k_event_post(&dma_event, DMA_CHANNEL1_EV ); 
    }
    
}


static volatile void * dma1ch2_last_target = NULL;

int dma1ch2_memcpy(void *destination , const void* source, size_t size ) {
IRQ_LOCKED {

    compiler_barrier();
    if(LL_DMA_IsEnabledChannel(DMA1, LL_DMA_CHANNEL_2) || !source || !destination) //already running
    {
        return EXIT_FAILURE;
    }

    dma1ch2_last_target = destination;
    LL_DMA_ConfigAddresses(DMA1, LL_DMA_CHANNEL_2,(uint32_t)source, (uint32_t)destination, LL_DMA_DIRECTION_MEMORY_TO_MEMORY);
    LL_DMA_SetDataLength(DMA1, LL_DMA_CHANNEL_2, size);
    LL_DMA_EnableChannel(DMA1, LL_DMA_CHANNEL_2);
}
return EXIT_SUCCESS;
}


void DMA1_Channel2_IRQHandler(const void *arg)
{
    ARG_UNUSED(arg);

    if (LL_DMA_IsActiveFlag_TC2(DMA1)) {  // Transfer Complete
        LL_DMA_ClearFlag_TC2(DMA1);   // Clear flag

        LL_DMA_DisableChannel(DMA1, LL_DMA_CHANNEL_2);

        if(buffers_ready)
        {
            buffers_ready--;
        }

        if(k_event_test(&dma_event, DMA_CHANNEL2_DISABLE))
        {
            //lost transfer; invalidate the queue TODO
            proc_invalidate();
            goto finalize;
        }

        proc_sup_next_buffer(dma1ch2_last_target);

        if(!buffers_ready /*or queue filling up*/) //no more data to be transferred; ML may start processing
        {
            k_event_post(&dma_event, DMA_CHANNEL2_DISABLE);
            goto finalize;
        }

        volatile uint16_t * next_address;
        proc_acq_next_buffer(&next_address);
        dma1ch2_memcpy((void*)next_address ,(void*)adc_buffer[dma1ch1_oldest()], FFT_SIZE );

finalize:
        k_event_post(&dma_event, DMA_CHANNEL2_EV);   
    }
    
}




void configure_dma1(void)
{

    /**
     * @brief Channel 1 - ADC to MEM
     * 
     */

    LL_AHB1_GRP1_EnableClock(LL_AHB1_GRP1_PERIPH_DMA1);
    DMA1_Channel1->CCR = 0; // Clear config first

    LL_DMA_ConfigAddresses(DMA1, LL_DMA_CHANNEL_1, 
        LL_ADC_DMA_GetRegAddr(ADC1, LL_ADC_DMA_REG_REGULAR_DATA), 
        (uint32_t)adc_buffer, 
        LL_DMA_DIRECTION_PERIPH_TO_MEMORY
    );
    LL_DMA_SetDataTransferDirection(DMA1, LL_DMA_CHANNEL_2, LL_DMA_DIRECTION_PERIPH_TO_MEMORY);
    LL_DMA_SetDataLength(DMA1 ,LL_DMA_CHANNEL_1, FFT_SIZE);
    LL_DMA_SetMode(DMA1, LL_DMA_CHANNEL_1 , LL_DMA_MODE_NORMAL);
    LL_DMA_SetPeriphSize(DMA1, LL_DMA_CHANNEL_1, LL_DMA_PDATAALIGN_HALFWORD);
    LL_DMA_SetMemorySize(DMA1, LL_DMA_CHANNEL_1, LL_DMA_MDATAALIGN_HALFWORD);
    LL_DMA_SetChannelPriorityLevel(DMA1 , LL_DMA_CHANNEL_1, LL_DMA_PRIORITY_HIGH);
    LL_DMA_SetPeriphIncMode(DMA1, LL_DMA_CHANNEL_1, LL_DMA_PERIPH_NOINCREMENT );
    LL_DMA_SetMemoryIncMode(DMA1, LL_DMA_CHANNEL_1, LL_DMA_MEMORY_INCREMENT); 

    //LL_DMA_EnableIT_HT(DMA1,LL_DMA_CHANNEL_1);   
    LL_DMA_EnableIT_TC(DMA1,LL_DMA_CHANNEL_1);   
    IRQ_CONNECT(DMA1_Channel1_IRQn,     /* NOT TIM1_IRQn */
            1,               /* priority */
            DMA1_Channel1_IRQHandler,
            NULL,
            0);
    irq_enable(DMA1_Channel1_IRQn);

    /**
     * @brief Channel 2 - MEM to MEM
     * 
     */


    DMA1_Channel2->CCR = 0;
    LL_DMA_SetDataLength(DMA1 ,LL_DMA_CHANNEL_2, FFT_SIZE);
    LL_DMA_SetMode(DMA1, LL_DMA_CHANNEL_2 , LL_DMA_MODE_NORMAL);
    LL_DMA_SetPeriphSize(DMA1, LL_DMA_CHANNEL_2, LL_DMA_PDATAALIGN_HALFWORD);
    LL_DMA_SetMemorySize(DMA1, LL_DMA_CHANNEL_2, LL_DMA_MDATAALIGN_HALFWORD);
    LL_DMA_SetChannelPriorityLevel(DMA1 , LL_DMA_CHANNEL_2, LL_DMA_PRIORITY_MEDIUM);
    LL_DMA_SetPeriphIncMode(DMA1, LL_DMA_CHANNEL_2, LL_DMA_PERIPH_INCREMENT );
    LL_DMA_SetMemoryIncMode(DMA1, LL_DMA_CHANNEL_2, LL_DMA_MEMORY_INCREMENT); 
    LL_DMA_SetDataTransferDirection(DMA1, LL_DMA_CHANNEL_2, LL_DMA_DIRECTION_MEMORY_TO_MEMORY);
    
    LL_DMA_EnableIT_TC(DMA1,LL_DMA_CHANNEL_2);   
    IRQ_CONNECT(DMA1_Channel2_IRQn,     /* NOT TIM1_IRQn */
            1,               /* priority */
            DMA1_Channel2_IRQHandler,
            NULL,
            0);
    irq_enable(DMA1_Channel2_IRQn);

}
```

## src/processor.c
```c
#include "processor.h"
#include "queue.h"
#include "common.h"
#include "dma_driver.h"

#include <zephyr/dsp/dsp.h>
#include <arm_math.h>


static volatile uint16_t data_buffer[FFT_SEGMENTS][FFT_SIZE] __attribute__((aligned(2)));;
DEFINE_QUEUE(ready_buffer, FFT_SEGMENTS); //hold the current FFT window & track its status

#include "ABcoef_arr.h"


//number of buffers that underwent an FFT
static volatile int ffted_buffers = 0;

void proc_invalidate()
{
  queue_reset(&ready_buffer);
  ffted_buffers = 0;
}




/**
 * @brief Pointer for the next elegible DMA buffer
 * 
 * @param uint8_t the amout of ready buffers
 * @return uint16_t* 
 * Meant for ISR context
 */
void proc_acq_next_buffer(volatile uint16_t ** buffer)
{
  volatile int * ready_count = dma1ch1_rdy_cnt();

  if(*ready_count >= BUFFER_COUNT) //may cause a race; minimal distorsion expected
  {
    proc_invalidate();
    *ready_count = 2;
    *buffer = data_buffer[0];
    return;
  }

  uint8_t data_cnt = queue_size(&ready_buffer);
  if(data_cnt == FFT_SEGMENTS) //full; re-using existing buffers
  {
    dequeue(&ready_buffer, (void**)buffer);
    if(ffted_buffers > 0)
    {
      ffted_buffers--;
    }
    return;
  }
  else //filling-up
  {
    *buffer = data_buffer[data_cnt];
    return;
  }
}

int proc_sup_next_buffer(volatile uint16_t * buffer)
{
  return enqueue(&ready_buffer, (void*)buffer);
}


static q15_t fft_buffer[FFT_SIZE * 2];

int proc_tick() {
int exit_status = EXIT_SUCCESS;

  
  if(ffted_buffers == ready_buffer.max_size) //an update has occured
  {
    exit_status = EXIT_FAILURE;
    goto cleanup;
  }
    
  //do the FFT on the frozen chain
  arm_rfft_instance_q15 S;
  arm_status status;

  // 1. Initialize the RFFT. 
  // This points to internal CMSIS tables for 256-point RFFT.
  status = arm_rfft_init_256_q15(&S, 0, 1);

  if (status != ARM_MATH_SUCCESS) {
    exit_status = (int)status; // Initialization failed
    goto cleanup;
  }

  for(; ffted_buffers < ready_buffer.size; ++ffted_buffers)
  {
    volatile uint16_t * buf_ptr;
    (void)queue_get(&ready_buffer, ffted_buffers, &buf_ptr ); 
    arm_rfft_q15(&S, (void*)buf_ptr , fft_buffer);
    arm_cmplx_mag_q15(fft_buffer+2, (void*)(buf_ptr+1), FFT_SIZE);
  }

//do the ML & hand out a decision

  


  if(ready_buffer.size < FFT_SEGMENTS) 
  {
    exit_status = 2; //all buffers not ready yet
    goto cleanup;
  }


  
// IRQ_LOCKED{
//   if(!dma1ch2_rdy() || LL_DMA_IsActiveFlag_TC2(DMA1))
//     goto cleanup;

//   volatile uint16_t * next_data;
//   proc_acq_next_buffer(&next_data);
//   dma1ch2_memcpy((void*)next_data, (void*)dma1ch1_get(dma1ch1_oldest()), FFT_SIZE);
// }


cleanup:
  return exit_status;
}
```

## src/queue.c
```c
#include "queue.h"

int enqueue(volatile Queue *queue, void *data) {
IRQ_LOCKED{
  if (queue->size >= queue->max_size) {
    return EXIT_FAILURE; // Queue full
  }
  queue->buffer[queue->front++] = data;
  queue->size++;
  queue->front %= queue->max_size;
}
  return EXIT_SUCCESS; // Success
}


int dequeue(volatile Queue *queue, void **result) {
IRQ_LOCKED{
  if (queue->size == 0) {
    *result = NULL;
    return EXIT_FAILURE; // Queue empty
  }
  // Calculate the back index (oldest element)
  uint8_t back = (queue->front - queue->size + queue->max_size) % queue->max_size;
  if(result)
    *result = queue->buffer[back];
  queue->size--;
}
  return EXIT_SUCCESS; // Success
}


int queue_get(const volatile Queue *queue, uint8_t n, void **result) { 
IRQ_LOCKED{
  if (n >= queue->size) {
    *result = NULL;
    return EXIT_FAILURE; // Index out of bounds
  }
  // Calculate the circular index for the n-th element (0 = oldest)
  uint8_t index = (queue->front - queue->size + n + queue->max_size) % queue->max_size;
  *result = queue->buffer[index];
}
  return EXIT_SUCCESS; // Success
}
```

## src/tim_driver.c
```c
#include "tim_driver.h"

#include <stm32_ll_gpio.h>
#include <stm32_ll_tim.h>
#include <stm32_ll_bus.h>


// void TIM1_UP_IRQn_IRQHandler(const void * arg)
// {
//     ARG_UNUSED(arg);

//     if(LL_TIM_IsActiveFlag_UPDATE(TIM1))
//         LL_TIM_ClearFlag_UPDATE(TIM1);

//     printk("HzTRG!");
// }


/**
 * @brief Orchestration trigger, slow (in Hz)
 * 
 */
void configure_tim1(void)
{
    LL_APB2_GRP1_EnableClock(LL_APB2_GRP1_PERIPH_TIM1);

    LL_TIM_SetPrescaler(TIM1, TIM1_PRESCALER);
    LL_TIM_SetAutoReload(TIM1, TIM1_AUTORELOAD);
    LL_TIM_SetCounterMode(TIM1, LL_TIM_COUNTERMODE_UP);

    //LL_TIM_OC_SetMode(TIM1, LL_TIM_CHANNEL_CH1, LL_TIM_OCMODE_PWM1);
    //LL_TIM_OC_SetCompareCH1(TIM1, TIM1_COMPARE);

    LL_TIM_SetTriggerOutput(TIM1, LL_TIM_TRGO_UPDATE );
    //LL_TIM_EnableAllOutputs(TIM1);

    // LL_TIM_CC_EnableChannel(TIM1, LL_TIM_CHANNEL_CH1);//the funky undocumented case

    // LL_TIM_EnableIT_UPDATE(TIM1);
    // IRQ_CONNECT(TIM1_UP_IRQn,     /* NOT TIM1_IRQn */
    //         0,               /* priority */
    //         TIM1_UP_IRQn_IRQHandler,
    //         NULL,
    //         0);
    // irq_enable(TIM1_UP_IRQn);
}


/**
 * @brief Direct ADC trigger, fast (in kHz)
 * 
 */
void configure_tim2(void)
{
    LL_APB1_GRP1_EnableClock(LL_APB1_GRP1_PERIPH_TIM2);

    LL_TIM_SetPrescaler(TIM2, TIM2_PRESCALER);
    LL_TIM_SetAutoReload(TIM2, TIM2_AUTORELOAD);
    LL_TIM_SetCounterMode(TIM2, LL_TIM_COUNTERMODE_UP);

    LL_TIM_OC_SetMode(TIM2, LL_TIM_CHANNEL_CH2, LL_TIM_OCMODE_PWM1);
    LL_TIM_OC_SetCompareCH2(TIM2, TIM2_COMPARE);

    LL_TIM_SetTriggerOutput(TIM2, LL_TIM_TRGO_OC2REF);
    LL_TIM_EnableAllOutputs(TIM2);
    LL_TIM_CC_EnableChannel(TIM2, LL_TIM_CHANNEL_CH2);//the funky undocumented case

    LL_TIM_SetTriggerInput(TIM2, LL_TIM_TS_ITR0);
    LL_TIM_SetSlaveMode(TIM2, LL_TIM_SLAVEMODE_TRIGGER);

    //#ifndef NDEBUG //OUT to PA1
    LL_APB2_GRP1_EnableClock(LL_APB2_GRP1_PERIPH_GPIOA);
    LL_GPIO_SetPinMode(GPIOA, LL_GPIO_PIN_1, LL_GPIO_MODE_ALTERNATE);
    LL_GPIO_SetPinOutputType(GPIOA, LL_GPIO_PIN_1, LL_GPIO_OUTPUT_PUSHPULL);
    LL_GPIO_SetPinSpeed(GPIOA, LL_GPIO_PIN_1, LL_GPIO_SPEED_FREQ_HIGH);
    //#endif
    

    // LL_TIM_EnableIT_CC1(TIM2);
    // IRQ_CONNECT(TIM2_IRQn,     /* NOT TIM1_IRQn */
    //         0,               /* priority */
    //         TIM2_IRQn_IRQHandler,
    //         NULL,
    //         0);
    // irq_enable(TIM2_IRQn);
}
```
